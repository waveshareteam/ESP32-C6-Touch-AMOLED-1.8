## examples/esp-idf/00_board_check/sdkconfig.defaults
```kconfig
CONFIG_IDF_TARGET="esp32c6"
CONFIG_ESPTOOLPY_FLASHMODE_QIO=y
CONFIG_ESPTOOLPY_FLASHSIZE_16MB=y
CONFIG_ESP_DEFAULT_CPU_FREQ_MHZ_160=y
CONFIG_PARTITION_TABLE_CUSTOM=y
```

## examples/esp-idf/00_bsp_quickstart/sdkconfig.defaults
```kconfig
CONFIG_IDF_TARGET="esp32c6"
CONFIG_ESPTOOLPY_FLASHMODE_QIO=y
CONFIG_ESPTOOLPY_FLASHSIZE_16MB=y
CONFIG_ESP_DEFAULT_CPU_FREQ_MHZ_160=y
CONFIG_PARTITION_TABLE_CUSTOM=y
CONFIG_FREERTOS_HZ=1000
CONFIG_BSP_DISPLAY_LVGL_BUF_HEIGHT=40
CONFIG_LV_FONT_MONTSERRAT_20=y
```

## examples/esp-idf/01_AXP2101/sdkconfig.defaults
```kconfig
CONFIG_I2C_MASTER_PORT_NUM=0
CONFIG_I2C_MASTER_FREQUENCY=100000
CONFIG_PMU_I2C_SCL=7
CONFIG_PMU_I2C_SDA=8
CONFIG_PMU_INTERRUPT_PIN=-1
```

## examples/esp-idf/03_esp-brookesia/components/brookesia_core/Kconfig
```kconfig
menu "ESP Brookesia - Core Configurations"
    menuconfig ESP_BROOKESIA_ENABLE_GUI
        bool "GUI"
        default y

    if ESP_BROOKESIA_ENABLE_GUI
        rsource "gui/Kconfig"
    endif

    menuconfig ESP_BROOKESIA_ENABLE_SERVICES
        bool "Services"
        default y

    if ESP_BROOKESIA_ENABLE_SERVICES
        rsource "services/Kconfig"
    endif

    menuconfig ESP_BROOKESIA_ENABLE_SYSTEMS
        bool "Systems"
        default y

    if ESP_BROOKESIA_ENABLE_SYSTEMS
        rsource "systems/Kconfig"
    endif
endmenu
```

## examples/esp-idf/05_LVGL_WITH_RAM/sdkconfig.defaults
```kconfig
CONFIG_IDF_TARGET="esp32c6"
CONFIG_ESPTOOLPY_FLASHMODE_QIO=y
CONFIG_ESPTOOLPY_FLASHSIZE_16MB=y
CONFIG_PARTITION_TABLE_CUSTOM=y
CONFIG_COMPILER_OPTIMIZATION_PERF=y
CONFIG_ESP_DEFAULT_CPU_FREQ_MHZ_160=y
CONFIG_FREERTOS_HZ=1000
CONFIG_BSP_DISPLAY_LVGL_BUF_HEIGHT=40
CONFIG_LV_FONT_MONTSERRAT_12=y
CONFIG_LV_FONT_MONTSERRAT_16=y
CONFIG_LV_FONT_MONTSERRAT_22=y
CONFIG_LV_FONT_MONTSERRAT_32=y
CONFIG_LV_USE_DEMO_MUSIC=y
```
